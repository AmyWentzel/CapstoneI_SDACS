## ESP-IDF/firmware/mic_test/sdkconfig.defaults
```kconfig
CONFIG_IDF_TARGET="esp32s3"
CONFIG_BT_ENABLED=y
CONFIG_BT_NIMBLE_ENABLED=y
CONFIG_BT_NIMBLE_ROLE_BROADCASTER=y


# Adafruit Metro ESP32-S3 hardware
CONFIG_ESPTOOLPY_FLASHSIZE_16MB=y

# SDACS OTA-capable flash layout
CONFIG_PARTITION_TABLE_CUSTOM=y
CONFIG_PARTITION_TABLE_CUSTOM_FILENAME="partitions.csv"
```
